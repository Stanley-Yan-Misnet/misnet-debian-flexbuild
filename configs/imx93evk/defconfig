## configs/misnet-production/defconfig
```kconfig
# MISNET production: ES001 RevA using the i.MX93 EVK BSP baseline.
# Component selection follows the existing project .config.
CONFIG_SOC_MISNET_IMX93_ES001_REVA=y
CONFIG_MISNET_PRODUCTION=y
CONFIG_LINUX_DTB="imx93-11x11-evk.dtb"
CONFIG_PLATFORM_IMX=y
CONFIG_JOBS=8
CONFIG_BUILD_VERBOSE=n
CONFIG_KEEP_GIT=n
CONFIG_OPTEE=n
CONFIG_DEBIAN_MIRRORS="http://deb.debian.org/debian"
CONFIG_LINUX_EXTRA_CONFIG="misnet-production.config"
CONFIG_CUSTOM_SDK_CONFIG=""
CONFIG_LINUX_KMOD=y
CONFIG_CRYPTODEV_LINUX=y
CONFIG_NXP_WLAN_BT=y
CONFIG_APP_GRAPHICS=y
CONFIG_GFX_IMX_G2D_SAMPLES=y
CONFIG_GFX_IMX_PXP_G2D=y
CONFIG_GFX_VULKAN_HEADERS=y
CONFIG_GFX_LIBDRM=y
CONFIG_GFX_WAYLAND_PROTOCOLS=y
CONFIG_GFX_WESTON=y
CONFIG_APP_MULTIMEDIA=y
CONFIG_MM_ALSA_LIB=y
CONFIG_MM_ALSA_STATE=y
CONFIG_MM_GSTREAMER=y
CONFIG_MM_GST_PLUGINS_BASE=y
CONFIG_MM_GST_PLUGINS_GOOD=y
CONFIG_MM_GST_PLUGINS_BAD=y
CONFIG_MM_GST_PYTHON=y
CONFIG_MM_IMX_ALSA_PLUGIN=y
CONFIG_MM_IMX_CODEC=y
CONFIG_MM_IMX_GST_PLUGIN=y
CONFIG_MM_IMX_LIB=y
CONFIG_MM_IMX_PARSER=y
CONFIG_MM_IMX_SW_PDM=y
CONFIG_MM_SOF_ZEPHYR=y
CONFIG_APP_ML=y
CONFIG_ML_EIQ_EXAMPLES=y
CONFIG_ML_ETHOSU_DRIVER_STACK=y
CONFIG_ML_ETHOSU_FIRMWARE=y
CONFIG_ML_ETHOSU_VELA=y
CONFIG_ML_FLATBUFFERS=y
CONFIG_ML_NNSTREAMER_EDGE=y
CONFIG_ML_NNSTREAMER=y
CONFIG_ML_SSAT=y
CONFIG_ML_TFLITE_ETHOSU_DELEGATE=y
CONFIG_ML_TFLITE=y
CONFIG_APP_GOPOINT=y
CONFIG_GP_IMX_DEMO_EXPERIENCE=y
CONFIG_GP_IMX_DEMOS_LIST=y
CONFIG_GP_IMX_EBIKE_VIT=y
CONFIG_GP_IMX_ELE=y
CONFIG_GP_IMX_NNSTREAMER_EXAMPLES=y
CONFIG_GP_IMX_SMART_FITNESS=y
CONFIG_GP_IMX_SMART_KITCHEN=y
CONFIG_GP_NXP_AFE=y
CONFIG_APP_NETWORKING=y
CONFIG_NET_DPDK=y
CONFIG_NET_TSNTOOL=y
CONFIG_APP_UTILS=y
CONFIG_UTILS_FIRMWARED=y
CONFIG_UTILS_IMX_FIRMWARE=y
CONFIG_UTILS_MCORE_DEMO=y
CONFIG_UTILS_WIRELESS_REGDB=y
CONFIG_UTILS_FIRMWARE_IMX=y
CONFIG_UTILS_PERF=y
CONFIG_APP_SECURITY=y
CONFIG_SEC_CRCONF=y
CONFIG_SEC_ECC_EXAMPLE=y
CONFIG_SEC_IMX_SECURE_ENCLAVE=y
CONFIG_SEC_KEYCTL_CAAM=y
CONFIG_SEC_MBEDTLS=y
CONFIG_SEC_OPENSSL=y
CONFIG_SEC_OPENSSL_PROVIDER_SE05X=n
```
